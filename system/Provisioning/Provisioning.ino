// Provisioning sketch — flash ONCE to write the HMAC key into ESP32 NVS.
// After flashing, replace with PasskeyLock.ino for normal operation.
// The key persists in NVS across power cycles and firmware updates.
//
// Usage:
//   1. Paste your 64-char hex secret from the web portal below.
//   2. Flash to the ESP32.
//   3. Open Serial Monitor (115200). You should see "Key written OK."
//   4. Flash PasskeyLock.ino.

#include <Preferences.h>

// Replace with the secret generated by the web portal (64 hex chars = 32 bytes)
static const char SECRET_HEX[] = "0000000000000000000000000000000000000000000000000000000000000000";

static const char* NVS_NAMESPACE  = "passkey";
static const char* NVS_KEY_SECRET = "secret";

void setup() {
    Serial.begin(115200);
    while (!Serial) {}

    if (strlen(SECRET_HEX) != 64) {
        Serial.println("ERROR: SECRET_HEX must be exactly 64 hex characters (32 bytes).");
        return;
    }

    uint8_t buf[32];
    for (uint8_t i = 0; i < 32; i++) {
        char byteStr[3] = { SECRET_HEX[i * 2], SECRET_HEX[i * 2 + 1], '\0' };
        buf[i] = (uint8_t)strtol(byteStr, nullptr, 16);
    }

    Preferences prefs;
    prefs.begin(NVS_NAMESPACE, /*readOnly=*/false);
    size_t written = prefs.putBytes(NVS_KEY_SECRET, buf, 32);
    prefs.end();

    if (written != 32) {
        Serial.println("ERROR: NVS write failed.");
        return;
    }

    // Verify readback
    uint8_t verify[32];
    prefs.begin(NVS_NAMESPACE, /*readOnly=*/true);
    size_t read = prefs.getBytes(NVS_KEY_SECRET, verify, 32);
    prefs.end();

    bool ok = (read == 32) && (memcmp(buf, verify, 32) == 0);
    Serial.println(ok ? "Key written OK. Flash PasskeyLock.ino now."
                      : "ERROR: Readback mismatch!");
}

void loop() {}
